## lib/Kconfig.dysche
```kconfig
config EULER_DYSCHE
    bool "Support for the Dysche Solution."
    depends on HOTPLUG_CPU
    default y if ARM64
    select ARM_GIC_V3 if ARM64
    select ARM_GIC_V3_ITS if ARM64
    default y if RISCV
    default n
    help
        Support for the Dysche Solution
```
